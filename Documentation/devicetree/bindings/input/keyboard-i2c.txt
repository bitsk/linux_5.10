## Documentation/devicetree/bindings/input/keyboard-i2c.txt
```
M5Stack CardKB I2C键盘驱动绑定

必需属性：
- compatible: 必须是 "keyboard-i2c"
- reg: I2C设备地址

示例：
    keyboard@5f {
        compatible = "keyboard-i2c";
        reg = <0x5f>;
    }; 
```

## drivers/input/keyboard/i2c/Kconfig
```kconfig
config KEYBOARD_I2C
    tristate "I2C Keyboard support"
    depends on I2C
    help
      Say Y here if you want to use an I2C connected keyboard.
      
      To compile this driver as a module, choose M here: the
      module will be called keyboard-i2c. 
```
